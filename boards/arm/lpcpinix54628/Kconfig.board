## boards/arm/lpcpinix54628/Kconfig.board
```kconfig
# LPCXpresso11U68 board

# Copyright (c) 2020, Seagate
# SPDX-License-Identifier: Apache-2.0

config BOARD_LPCPINIX54628
	bool "NXP LPCPINIX-54628"
	depends on SOC_SERIES_LPC11U6X
	select SOC_PART_NUMBER_LPC11U68JBD100
```

## boards/arm/lpcpinix54628/Kconfig.defconfig
```kconfig
# LPCXpresso11U68 board

# Copyright (c) 2020, Seagate
# SPDX-License-Identifier: Apache-2.0

if BOARD_LPCPINIX54628

config BOARD
	default "lpcpinix54628"

config GPIO_MCUX
	default y

endif # BOARD_LPCPINIX54628
```

## boards/arm/lpcpinix54628/lpcpinix54628_defconfig
```kconfig
#CONFIG_UART_INTERRUPT_DRIVEN=y
CONFIG_SYS_CLOCK_HW_CYCLES_PER_SEC=48000000
CONFIG_GPIO=y
CONFIG_PINMUX=y
CONFIG_BUILD_OUTPUT_HEX=y
CONFIG_SOC_SERIES_LPC546XX=y
# Since the board has little memory (32k), stack sizes are lowered
# so that the application has more RAM for itself.
CONFIG_MAIN_STACK_SIZE=512
CONFIG_ISR_STACK_SIZE=768

CONFIG_CONSOLE=y
CONFIG_UART_CONSOLE=y
CONFIG_SERIAL=y
CONFIG_UART_MCUX_FLEXCOMM=y
CONFIG_PWM_MCUX_SCTIMER=y
CONFIG_PINMUX_MCUX_LPC=y
#CONFIG_EEPROM=y
CONFIG_ARM_MPU=y
```

## soc/arm/nxp_lpc/Kconfig
```kconfig
# Copyright (c) 2017, NXP
# SPDX-License-Identifier: Apache-2.0

config SOC_FAMILY_LPC
	bool
	select HAS_SEGGER_RTT

if SOC_FAMILY_LPC

config SOC_FAMILY
	string
	default "nxp_lpc"

rsource "*/Kconfig.soc"

endif # SOC_FAMILY_LPC
```

## soc/arm/nxp_lpc/Kconfig.soc
```kconfig
# Copyright (c) 2017, NXP
# SPDX-License-Identifier: Apache-2.0

rsource "*/Kconfig.series"
```

## soc/arm/nxp_lpc/lpc546xx/Kconfig.defconfig.lpc54628
```kconfig
# NXP LPC11U68 platform configuration options

# Copyright (c) 2020, Seagate
# SPDX-License-Identifier: Apache-2.0

if SOC_LPC54628

config SOC
	default "lpc54628"

endif # SOC_LPC54628
```

## soc/arm/nxp_lpc/lpc546xx/Kconfig.defconfig.series
```kconfig
# LPC11U6X series configuration options

# Copyright (c) 2020, Seagate
# SPDX-License-Identifier: Apache-2.0

if SOC_SERIES_LPC546XX

rsource "Kconfig.defconfig.lp*"

config SOC_SERIES
	default "lpc546xx"

config NUM_IRQS
	# must be >= the highest interrupt number used
	default 40

if PINMUX

# The pinmux device must be initialized before all the other devices, including
# the clock control device which uses it.

config PINMUX_INIT_PRIORITY
	default 1

endif # PINMUX

config GPIO_MCUX_LPC
	default y
	depends on PINMUX

endif # SOC_SERIES_LPC546XX
```

## soc/arm/nxp_lpc/lpc546xx/Kconfig.series
```kconfig
# LPC LPC11U6X MCU line

# Copyright (c) 2020, Seagate
# SPDX-License-Identifier: Apache-2.0

config SOC_SERIES_LPC546XX
	bool "LPC LPC546XX Series MCU"
	select ARM
	select HAS_MCUX
	select HAS_MCUX_FLEXCOMM
	select CPU_HAS_FPU
	select HAS_MCUX_SYSCON
	select HAS_MCUX_PWM
	select HAS_MCUX_SCTIMER
	select SOC_FAMILY_LPC
	select CPU_CORTEX_M_HAS_SYSTICK
	help
	  Enable support for LPC LPC546XX MCU series
```

## soc/arm/nxp_lpc/lpc546xx/Kconfig.soc
```kconfig
# LPC LPC11U6x MCU line

# Copyright (c) 2020, Seagate
# SPDX-License-Identifier: Apache-2.0

choice
	prompt "LPC LPC546XX MCU Selection"
	depends on SOC_SERIES_LPC546XX

config SOC_LPC54628
	bool "SOC_LPC54628"
	select CPU_CORTEX_M4
	select CPU_CORTEX_M_HAS_DWT
	select PLATFORM_SPECIFIC_INIT
	select CLOCK_CONTROL

endchoice

if SOC_SERIES_LPC546XX

config SOC_PART_NUMBER_LPC54628ABCD
	bool

endif # SOC_SERIES_LPC546XX
```
